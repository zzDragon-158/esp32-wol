## main/Kconfig.projbuild
```kconfig
menu "ESP32 WOL Configuration"

    menu "ESP_WOL Configuration"
        comment "SoftAP Configuration"

        config ESP_WIFI_AP_SSID
            string "WiFi AP SSID"
            default "ESP32-WOL"
            help
                SSID (network name) of the AP for the example to connect to.

        config ESP_WIFI_AP_PASSWORD
            string "WiFi AP Password"
            default "123321a."
            help
                WiFi password of the AP for the example to use.

        config ESP_WIFI_AP_CHANNEL
            int "WiFi AP Channel"
            range 1 14
            default 1
            help
                WiFi channel (network channel) of the AP for the example to use.

        config ESP_MAX_STA_CONN_AP
            int "Maximal STA connections"
            default 4
            help
                Max number of the STA connects to AP.

        comment "STA Configuration"
        
        choice ESP_WIFI_STA_SCAN
            prompt "STA scan method"
            default ESP_WIFI_STA_SCAN_FAST
            help
                Select the STA scan method.
                Full scan can scan more SSIDs, but it may cause slower web response.

            config ESP_WIFI_STA_SCAN_FAST
                bool "fast"
            config ESP_WIFI_STA_SCAN_FULL
                bool "full"
        endchoice
    endmenu

    menu "ESP_BLINK Configuration"

        orsource "$IDF_PATH/examples/common_components/env_caps/$IDF_TARGET/Kconfig.env_caps"

        choice BLINK_LED
            prompt "Blink LED type"
            default BLINK_LED_GPIO
            help
                Select the LED type. A normal level controlled LED or an addressable LED strip.
                The default selection is based on the Espressif DevKit boards.
                You can change the default selection according to your board.

            config BLINK_LED_GPIO
                bool "GPIO"
            config BLINK_LED_STRIP
                bool "LED strip"
        endchoice

        choice BLINK_LED_STRIP_BACKEND
            depends on BLINK_LED_STRIP
            prompt "LED strip backend peripheral"
            default BLINK_LED_STRIP_BACKEND_RMT if SOC_RMT_SUPPORTED
            default BLINK_LED_STRIP_BACKEND_SPI
            help
                Select the backend peripheral to drive the LED strip.

            config BLINK_LED_STRIP_BACKEND_RMT
                depends on SOC_RMT_SUPPORTED
                bool "RMT"
            config BLINK_LED_STRIP_BACKEND_SPI
                bool "SPI"
        endchoice

        config BLINK_GPIO
            int "Blink GPIO number"
            range ENV_GPIO_RANGE_MIN ENV_GPIO_OUT_RANGE_MAX
            default 8
            help
                GPIO number (IOxx) to blink on and off the LED.
                Some GPIOs are used for other purposes (flash connections, etc.) and cannot be used to blink.

        config BLINK_PERIOD
            int "Blink period in ms"
            range 10 3600000
            default 1000
            help
                Define the blinking period in milliseconds.

    endmenu
endmenu
```
